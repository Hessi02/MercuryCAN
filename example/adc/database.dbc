VERSION ""

NS_ :

BS_:

BU_:

BO_ 1 Measurement: 2 Vector__XXX
	SG_ Voltage : 0|16@1+ (0.001,0) [0|5] "V" Vector__XXX
