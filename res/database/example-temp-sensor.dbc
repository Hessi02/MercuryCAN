VERSION ""

NS_ :

BS_:

BU_:

BO_ 256 measurement: 3 Vector__XXX
	SG_ temperature : 7|16@0- (0.01,0) [-20|80] "°C" Vector__XXX
	SG_ rollingCounter : 16|8@1+ (1,0) [0|0] "" Vector__XXX

BO_ 86 status: 5 Vector__XXX
	SG_ systemState : 0|8@1+ (1,0) [0|10] "" Vector__XXX
	SG_ systemTime : 8|32@1+ (0.001,0) [0|0] "s" Vector__XXX

CM_ BO_ 256 "Ambient temperature measurement";
CM_ SG_ 256 temperature "Ambient temperature";
CM_ SG_ 256 rollingCounter "Self incrementing counter";
CM_ BO_ 86 "Temperature sensor state";
CM_ SG_ 86 systemState "Internal system state";
CM_ SG_ 86 systemTime "Driver tick count";

BA_DEF_ BO_  "VFrameFormat" ENUM  "StandardCAN","ExtendedCAN","reserved","J1939PG";
BA_DEF_  "DatabaseVersion" STRING ;
BA_DEF_  "BusType" STRING ;
BA_DEF_  "ProtocolType" STRING ;
BA_DEF_DEF_  "VFrameFormat" "StandardCAN";
BA_DEF_DEF_  "DatabaseVersion" "1.0.0";
BA_DEF_DEF_  "BusType" "CAN";
BA_DEF_DEF_  "ProtocolType" "";
